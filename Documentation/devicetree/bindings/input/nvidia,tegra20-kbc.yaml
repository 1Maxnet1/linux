## Documentation/devicetree/bindings/input/nvidia,tegra20-kbc.yaml
```yaml
# SPDX-License-Identifier: (GPL-2.0-only OR BSD-2-Clause)
%YAML 1.2
---
$id: "http://devicetree.org/schemas/input/nvidia,tegra20-kbc.yaml#"
$schema: "http://devicetree.org/meta-schemas/core.yaml#"

title: Nvidia Tegra keyboard controller

maintainers:
  - Jon Hunter <jonathanh@nvidia.com>
  - Sameer Pujar <spujar@nvidia.com>

description: The key controller has maximum 24 pins to make matrix keypad. Any pin
  can be configured as row or column.

allOf:
  - $ref: "/schemas/input/matrix-keymap.yaml#"

properties:
  compatible:
    oneOf:
      - items:
          - const: nvidia,tegra30-kbc 
          - const: nvidia,tegra20-kbc
      - items:
          - const: nvidia,tegra20-kbc

  reg:
    maxItems: 1

  interrupts:
    maxItems: 1

  nvidia,kbc-row-pins:
    description: KBC pins which are configured as row
    minItems: 1
    maxItems: 16
    $ref: /schemas/types.yaml#/definitions/uint32-array

  nvidia,kbc-col-pins:
    description: KBC pins which are configured as column
    minItems: 1
    maxItems: 8
    $ref: /schemas/types.yaml#/definitions/uint32-array

  clocks:
    maxItems: 1

  resets:
    maxItems: 1

  reset-names:
    const: kbc

  linux,fn-keymap:
    description: a secondary keymap to be used when the KEY_FN modifier key is pressed

  nvidia,debounce-delay-ms:
    description: delay in milliseconds per row scan for debouncing

  nvidia,repeat-delay-ms:
    description: delay in milliseconds before repeat starts

  nvidia,ghost-filter:
    description: enable ghost filtering for this device
    type: boolean

  wakeup-source:
    description: configure keyboard as a wakeup source for suspend/resume

required:
  - compatible
  - reg
  - interrupts
  - nvidia,kbc-row-pins
  - nvidia,kbc-col-pins
  - linux,keymap
  - clocks
  - resets
  - reset-names

unevaluatedProperties: false

examples:
  - |
    #include <dt-bindings/interrupt-controller/arm-gic.h>
    
    keyboard@7000e200 {
        compatible = "nvidia,tegra20-kbc";
        reg = <0x7000e200 0x100>;
        interrupts = <GIC_SPI 85 IRQ_TYPE_LEVEL_HIGH>;
        clocks = <&tegra_car 36>;
        resets = <&tegra_car 36>;
        reset-names = "kbc";
        nvidia,ghost-filter;
        nvidia,debounce-delay-ms = <640>;
        nvidia,kbc-row-pins = <0 1 2>;    /* pin 0, 1, 2 as rows */
        nvidia,kbc-col-pins = <11 12 13>; /* pin 11, 12, 13 as columns */
        linux,keymap = <0x00000074
                        0x00010067
                        0x00020066
                        0x01010068
                        0x02000069
                        0x02010070
                        0x02020071>;
    };
```
